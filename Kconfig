## Kconfig
```kconfig
config ZMK_INPUT_PROCESSOR_BLE_PROFILE_TRANSFORM
    bool "BLE profile transform input processor"
    default y
    depends on DT_HAS_ZMK_INPUT_PROCESSOR_BLE_PROFILE_TRANSFORM_ENABLED && ZMK_INPUT_LISTENER && ZMK_BLE
```

## dts/bindings/input_processors/zmk,input-processor-ble-profile-transform.yaml
```yaml
# SPDX-License-Identifier: MIT

description: Input processor for inverting values only on selected BLE profiles

compatible: "zmk,input-processor-ble-profile-transform"

include: ip_one_param.yaml

properties:
  type:
    type: int
  x-codes:
    type: array
    required: true
  y-codes:
    type: array
    required: true
  profiles:
    type: array
    required: true
```
